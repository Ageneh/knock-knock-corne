#include "knock_knock.dtsi"

&kscan0 {
    row-gpios
      = <&pro_micro 21 (GPIO_ACTIVE_HIGH | GPIO_PULL_DOWN)> /* RR0 */
      , <&pro_micro 19 (GPIO_ACTIVE_HIGH | GPIO_PULL_DOWN)> /* RR1 */
      , <&pro_micro 7 (GPIO_ACTIVE_HIGH | GPIO_PULL_DOWN)> /* RR2 */
      , <&pro_micro 14 (GPIO_ACTIVE_HIGH | GPIO_PULL_DOWN)> /* RR3 */
      ;

  col-gpios
    = <&pro_micro 15 GPIO_ACTIVE_HIGH>  /* RC0 (RC_TOTAL_6) */
    , <&pro_micro 6 GPIO_ACTIVE_HIGH>  /* RC1 (RC_TOTAL_7) */
    , <&pro_micro 18 GPIO_ACTIVE_HIGH> /* RC2 (RC_TOTAL_8) */
    , <&pro_micro 5 GPIO_ACTIVE_HIGH> /* RC3 (RC_TOTAL_9) */
    , <&pro_micro 4 GPIO_ACTIVE_HIGH> /* RC4 (RC_TOTAL_10) */
    , <&pro_micro 20 GPIO_ACTIVE_HIGH> /* RC5 (RC_TOTAL_11) */
     ;
};

&default_transform {
  col-offset = <6>;
};
